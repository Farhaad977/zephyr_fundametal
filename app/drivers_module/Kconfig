## app/drivers_module/drivers/samp_driver/Kconfig
```kconfig
config SAMP_DRIVER
    bool "Sample Driver"
    default y
    depends on DT_HAS_SAMP_DRIVER_ENABLED
```

## boards/custom_board1/Kconfig.custom_board1
```kconfig
config BOARD_CUSTOM_BOARD1 	#Config contains the name of our board:Custom_Board1
	select SOC_STM32F446XX
```

## boards/custom_board1/Kconfig.defconfig
```kconfig
# Custom Board1 board configuration

if BOARD_CUSTOM_BOARD1

config SPI_STM32_INTERRUPT
	default y
	depends on SPI

endif # BOARD_CUSTOM_BOARD1
```

## boards/custom_board1/board.yml
```yaml
board:
  name: custom_board1
  full_name: Custom Board1
  vendor: random
  socs:
    - name: stm32f446xx
```

## boards/custom_board2/Kconfig.custom_board2
```kconfig
config BOARD_CUSTOM_BOARD2  #Here board name: Custom Board2
    select SOC_STM32F446XX
```

## boards/custom_board2/board.yml
```yaml
board:
  name: custom_board2
  full_name: Custom Board2
  vendor: random
  socs:
    - name: stm32f446xx
```
