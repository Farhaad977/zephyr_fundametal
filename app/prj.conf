## CMakeLists.txt
```
cmake_minimum_required(VERSION 3.20.0)
list(APPEND BOARD_ROOT ${CMAKE_CURRENT_SOURCE_DIR}/..) #Modified to show the Root Directory
list(APPEND ZEPHYR_EXTRA_MODULES ${CMAKE_CURRENT_SOURCE_DIR}/drivers_module)
find_package(Zephyr REQUIRED)
zephyr_include_directories(drivers_module/include/samp_driver)  #Module Include directories added
set(CMAKE_EXPORT_COMPILE_COMMANDS ON)
project(led_blink)

target_sources(app PRIVATE src/main.cpp)
```

## Kconfig
```
menuconfig LED_SUBSYSTEM    #Outermost menuconfig displayed as "LED Subsystem"
bool "LED Subsystem"
default y                   #Set by default

if LED_SUBSYSTEM

config APP_HEARTBEAT_PERIOD_MS         #Kconfig added to be used with app_led
int     "LED Heartbeat Duration(ms)"
default 500
range 100 2000

choice
    prompt "LED blink sleep time"
    default BLINK_SLEEP_TIME_1000MS

config BLINK_SLEEP_TIME_250MS
bool "250ms (very fast)"

config BLINK_SLEEP_TIME_500MS
bool "500ms (fast)"

config BLINK_SLEEP_TIME_1000MS
bool "1s (medium)"

config BLINK_SLEEP_TIME_2000MS
bool "2s (slow)"
endchoice

config BLINK_SLEEP_TIME_MS
int         #Hidden
default 250 if BLINK_SLEEP_TIME_250MS
default 500 if BLINK_SLEEP_TIME_500MS
default 1000 if BLINK_SLEEP_TIME_1000MS
default 2000 if BLINK_SLEEP_TIME_2000MS
default 0

menuconfig ADVANCED_LED_SETTINGS        #Inner menuconfig
bool "Advanced LED settings"
default n

if ADVANCED_LED_SETTINGS                #When enabled, shows LED_BRIGHTNESS, LED_FADE_DURATION and Expert Settings

config LED_BRIGHTNESS
int "LED brightness (0-100)"
default 100
range 0 100                  

config LED_FADE_DURATION
int "LED fade duration (ms)"
default 500
range 0 5000 

menu "Expert Settings"
    visible if ADVANCED_LED_SETTINGS

config ENABLE_LED_DEBUGGING
bool "Enable LED debugging"

config CUSTOM_BLINK_PATTERN
bool "Custom blink pattern"

endmenu
endif
endif
source "Kconfig.zephyr"
rsource "drivers_module/drivers/samp_driver/Kconfig"
```

## prj.conf
```kconfig
CONFIG_GPIO=y
CONFIG_LOG=y
CONFIG_CPP=y
CONFIG_SHELL=y
```

## app.overlay
```dts
/{
    sled:sampled{
        compatible="samp,driver";
        gpios = <&gpioa 5 GPIO_ACTIVE_HIGH>;
        status="okay";
    };
};
```

## src/main.cpp
```c
#include <zephyr/drivers/sensor.h>
#include <zephyr/kernel.h>
#include <zephyr/logging/log.h>
#include <zephyr/drivers/gpio.h>
//#include "samp_driver.h"            //This needs to be mentioned in the app CMakeLists.txt file after the Zephyr package has been added

LOG_MODULE_REGISTER(main,LOG_LEVEL_INF);

const struct device *dev = DEVICE_DT_GET(DT_NODELABEL(sled)); //Here the *dev will the address of the struct dev that gets created when we use DEVICE_DT_INST_DEFINE(...)
int main(void){

    if(!device_is_ready(dev)) 
    {
        return -1;        //Need to include the <zephyr/drivers/device.h> 
    }

    //struct sensor_value val;         
    while(1)                           
    {
        //sensor_sample_fetch(dev);                                       //Calling a Generic API where we pass in the custom
        //read_param(dev);
        //change_param(dev, 32);
        k_msleep(CONFIG_APP_HEARTBEAT_PERIOD_MS);
        //sensor_channel_get(dev, SENSOR_CHAN_ALL,&val);        //Calling a Generic API where we pass in the custom
        k_msleep(CONFIG_APP_HEARTBEAT_PERIOD_MS); 
    }
    return 0;
}
```
